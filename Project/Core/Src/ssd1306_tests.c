#include "ssd1306.h"
#include "ssd1306_tests.h"

#define NUM_COLUMNS        8
#define COLUMN_WIDTH       16
#define COLUMN_HEIGHT      64
#define BYTES_PER_COLUMN   128
#define ANIM_HEIGHT        48      // top animated pixels
#define STATIC_HEIGHT      16      // bottom untouched




const unsigned char IS1300bild [] = {
	0x7f, 0xfe, 0x00, 0x00, 0x00, 0x00, 0x00, 0x00, 0x00, 0x00, 0x00, 0x00, 0x00, 0x00, 0x00, 0x00,
	0x7f, 0xfe, 0x00, 0x00, 0x00, 0x00, 0x00, 0x00, 0x00, 0x00, 0x00, 0x00, 0x00, 0x00, 0x00, 0x00,
	0x7f, 0xfe, 0x00, 0x00, 0x00, 0x00, 0x00, 0x00, 0x00, 0x00, 0x00, 0x00, 0x00, 0x00, 0x00, 0x00,
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	0x00, 0x00, 0x00, 0x00, 0x00, 0x00, 0x00, 0x00, 0x00, 0x00, 0x00, 0x00, 0x00, 0x00, 0x00, 0x00
};

// Array of all bitmaps for convenience. (Total bytes used to store images in PROGMEM = 1040)
const int allArray_LEN = 1;
const unsigned char* allArray[1] = {
	IS1300bild
};




unsigned char columns[NUM_COLUMNS][BYTES_PER_COLUMN];
unsigned char anim_columns[NUM_COLUMNS][BYTES_PER_COLUMN];



void ssd1306_AnimInit(void)
{
    for (int col = 0; col < NUM_COLUMNS; col++)
    {
        for (int row = 0; row < COLUMN_HEIGHT; row++)
        {
            int src_index  = row * 16 + col * 2;
            int dest_index = row * 2;
            columns[col][dest_index]     = IS1300bild[src_index];
            columns[col][dest_index + 1] = IS1300bild[src_index + 1];
        }
    }
}

// Show a frame per column
// frames[i] = 0 (full pillar) → 8 (black)
void ssd1306_AniFrame(int frames[NUM_COLUMNS])
{
    for (int col = 0; col < NUM_COLUMNS; col++)
    {
        int visible = ANIM_HEIGHT - (frames[col] * (ANIM_HEIGHT / 8)); // Shrink top part

        for (int row = 0; row < COLUMN_HEIGHT; row++)
        {
            int byte_index = row * 2;

            // Bottom static part: always copy from original
            if (row >= ANIM_HEIGHT)
            {
                anim_columns[col][byte_index]     = columns[col][byte_index];
                anim_columns[col][byte_index + 1] = columns[col][byte_index + 1];
            }
            // Animated top part
            else if (row >= (ANIM_HEIGHT - visible))
            {
                anim_columns[col][byte_index]     = columns[col][byte_index];
                anim_columns[col][byte_index + 1] = columns[col][byte_index + 1];
            }
            // Shrunk / blacked
            else
            {
                anim_columns[col][byte_index]     = 0x00;
                anim_columns[col][byte_index + 1] = 0x00;
            }
        }
    }

    // Draw all columns
    ssd1306_Fill(Black);
    for (int col = 0; col < NUM_COLUMNS; col++)
    {
        ssd1306_DrawBitmap(
            col * COLUMN_WIDTH,
            0,
            anim_columns[col],
            COLUMN_WIDTH,
            COLUMN_HEIGHT,
            White
        );
    }
    ssd1306_UpdateScreen();
}
